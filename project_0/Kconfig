## project_0/Kconfig
```kconfig
mainmenu "RT-Thread Project Configuration"

config BSP_DIR
    string
    option env="BSP_ROOT"
    default "."

config RTT_DIR
    string
    option env="RTT_ROOT"
    default "rt-thread"

config PKGS_DIR
    string
    option env="PKGS_ROOT"
    default "packages"

source "$RTT_DIR/Kconfig"
source "$PKGS_DIR/Kconfig"

config BOARD_K210_EVB
    bool
    select ARCH_RISCV64
    select ARCH_RISCV_FPU_S
    select PKG_USING_KENDRYTE_SDK
    select RT_USING_COMPONENTS_INIT
    select RT_USING_USER_MAIN
    default y

source "driver/Kconfig"

config __STACKSIZE__
    int "stack size for interrupt"
    default 4096

config RT_AI_USE_K210
	bool "RT-AK use the k210-KPU backend"
	default y

menu "mpy-extmods"
config PRJ_USING_EXTMODS_MISC
    bool "Enable MPY extmods"
    select PKG_USING_MICROPYTHON
    select MICROPYTHON_USING_USEREXTMODS
    default y

    if PRJ_USING_EXTMODS_MISC
        menuconfig EXTMODS_MISC_USING_K210
            bool "Enable K210 extmods"
            default y

            if EXTMODS_MISC_USING_K210
                config EXTMODS_K210_LCDCTL
                    bool "Enable LCD Control"
                    default y
                config EXTMODS_K210_DVP
                    bool "Enable DVP Camera"
                    select BSP_USING_CAMERA
                    default y
            endif

        config PRJ_USING_RT_AK_EXMODS
            bool "Enable RT-AK MPY module"
            default y
			
		config EXTMODS_K210_I2S
            bool "Enable I2S MPY module"
            default y
    endif
endmenu
```

## project_0/driver/Kconfig
```kconfig
menu "Hardware Drivers Config"

menu "IO Groups Power Supply Settings"

    choice
        prompt "voltage level for Group A -- Bank0~2"
        default BSP_GROUPA_POWER_SUPPLY_3V3
        
        config BSP_GROUPA_POWER_SUPPLY_1V8
            bool "1.8V"
        config BSP_GROUPA_POWER_SUPPLY_3V3
            bool "3.3V"
    endchoice

    choice
        prompt "voltage level for Group B -- Bank3~5"
        default BSP_GROUPB_POWER_SUPPLY_3V3
        
        config BSP_GROUPB_POWER_SUPPLY_1V8
            bool "1.8V"
        config BSP_GROUPB_POWER_SUPPLY_3V3
            bool "3.3V"
    endchoice

    choice
        prompt "voltage level for Group C -- Bank6~7"
        default BSP_GROUPC_POWER_SUPPLY_3V3
        
        config BSP_GROUPC_POWER_SUPPLY_1V8
            bool "1.8V"
        config BSP_GROUPC_POWER_SUPPLY_3V3
            bool "3.3V"
    endchoice

endmenu

config BSP_USING_UART_HS
    bool "Enable High Speed UART"
    default y

menu "General Purpose UARTs"

menuconfig BSP_USING_UART1
    bool "Enable UART1"
    default n
    if BSP_USING_UART1
        config BSP_UART1_TXD_PIN
            int "uart1 TXD pin number"
            default 20
        config BSP_UART1_RXD_PIN
            int "uart1 RXD pin number"
            default 21
    endif

menuconfig BSP_USING_UART2
    bool "Enable UART2"
    default n
    if BSP_USING_UART2
        config BSP_UART2_TXD_PIN
            int "uart2 TXD pin number"
            default 28
        config BSP_UART2_RXD_PIN
            int "uart2 RXD pin number"
            default 27
    endif

menuconfig BSP_USING_UART3
    bool "Enable UART3"
    default n
    if BSP_USING_UART3
        config BSP_UART3_TXD_PIN
            int "uart3 TXD pin number"
            default 22
        config BSP_UART3_RXD_PIN
            int "uart3 RXD pin number"
            default 23
    endif
endmenu

config BSP_USING_I2C0
    bool "Enable I2C0"
    select RT_USING_I2C
    default n
    if BSP_USING_I2C0
        config BSP_I2C0_SCL_PIN
            int "I2C0 SCL pin number"
            default 18
        config BSP_I2C0_SDA_PIN
            int "I2C0 SDA pin number"
            default 19
    endif

config BSP_USING_I2C1
    bool "Enable I2C1"
    select RT_USING_I2C
    default n
    if BSP_USING_I2C1
        config BSP_I2C1_SCL_PIN
            int "I2C1 SCL pin number"
            default 0
        config BSP_I2C1_SDA_PIN
            int "I2C1 SDA pin number"
            default 1
    endif

config BSP_USING_I2C2
    bool "Enable I2C2"
    select RT_USING_I2C
    default n
    if BSP_USING_I2C2
        config BSP_I2C2_SCL_PIN
            int "I2C2 SCL pin number"
            default 3
        config BSP_I2C2_SDA_PIN
            int "I2C2 SDA pin number"
            default 4
    endif

menuconfig BSP_USING_SPI1
    bool "Enable SPI1"
    select RT_USING_SPI
    default n
if BSP_USING_SPI1
    config BSP_USING_SPI1_AS_QSPI
        bool
        default n
    config BSP_SPI1_CLK_PIN
        int "spi1 clk pin number"
        default 29
    config BSP_SPI1_D0_PIN
        int "spi1 d0 pin number"
        default 30
    config BSP_SPI1_D1_PIN
        int "spi1 d1 pin number"
        default 31
    if BSP_USING_SPI1_AS_QSPI
        config BSP_SPI1_D2_PIN
            int "spi1 d2 pin number"
            default 32
        config BSP_SPI1_D3_PIN
            int "spi1 d3 pin number"
            default 33
    endif
    menuconfig BSP_SPI1_USING_SS0
        bool "SPI1 Enable SS0"
        default n
    if BSP_SPI1_USING_SS0
        config BSP_SPI1_SS0_PIN
            int "spi1 ss0 pin number"
            default 25
    endif
    menuconfig BSP_SPI1_USING_SS1
        bool "SPI1 Enable SS1"
        default n
    if BSP_SPI1_USING_SS1
        config BSP_SPI1_SS1_PIN
            int "spi1 ss1 pin number"
            default 22
    endif
    menuconfig BSP_SPI1_USING_SS2
        bool "SPI1 Enable SS2"
        default n
    if BSP_SPI1_USING_SS2
        config BSP_SPI1_SS2_PIN
            int "spi1 ss2 pin number"
            default 26
    endif
    menuconfig BSP_SPI1_USING_SS3
        bool "SPI1 Enable SS3"
        default n
    if BSP_SPI1_USING_SS3
        config BSP_SPI1_SS3_PIN
            int "spi1 ss3 pin number"
            default 27
    endif
endif

menuconfig BSP_USING_LCD
    bool "Enable LCD on SPI0"
    default n

if BSP_USING_LCD
    config BSP_LCD_CS_PIN
        int "CS pin number of 8080 interface"
        default 43
    config BSP_LCD_WR_PIN
        int "WR pin number of 8080 interface"
        default 45
    config BSP_LCD_DC_PIN
        int "DC pin number of 8080 interface"
        default 44
    config BSP_LCD_RST_PIN
        int "RESET pin number of 8080 interface (-1 for not used)"
        default 41
    config BSP_LCD_BACKLIGHT_PIN
        int "Backlight control pin number (-1 for not used)"
        default 47
    choice
        prompt "backlight active polarity"
        default BSP_LCD_BACKLIGHT_ACTIVE_HIGH
        
        config BSP_LCD_BACKLIGHT_ACTIVE_LOW
            bool "lcd backlight on low level"
        config BSP_LCD_BACKLIGHT_ACTIVE_HIGH
            bool "lcd_backlight on high level"
    endchoice

    config BSP_LCD_CLK_FREQ
        int "Lcd max clk frequency"
        default 18000000
    
    choice
        prompt "lcd scan direction"
        default BSP_BOARD_K210_DRACO

        config  BSP_BOARD_KD233
            bool "board_kd233 lcd scan: DIR_YX_RLUD"

        config  BSP_BOARD_K210_OPENMV_TEST
            bool "board_k210_openmv lcd scan: DIR_YX_LRUD"

        config  BSP_BOARD_K210_DRACO
            bool "board_k210_Draco lcd scan: DIR_YX_LRUD"

        config  BSP_BOARD_USER
            bool "board_user: user defined."    
    endchoice

    config BSP_LCD_X_MAX
        int "LCD Height"
        default 240
    config BSP_LCD_Y_MAX
        int "LCD Width"
        default 320
endif



menuconfig BSP_USING_TIMER0
    bool "Enable Timer0"
    select RT_USING_HWTIMER
    default n

    if BSP_USING_TIMER0
        config BSP_TIMER0_CHN0_ENABLE
            bool "Enable Timer0 Channel 0"
            default n
        config BSP_TIMER0_CHN1_ENABLE
            bool "Enable Timer0 Channel 1"
            default n
        config BSP_TIMER0_CHN2_ENABLE
            bool "Enable Timer0 Channel 2"
            default n
        config BSP_TIMER0_CHN3_ENABLE
            bool "Enable Timer0 Channel 3"
            default n                
    endif

menuconfig BSP_USING_TIMER1
    bool "Enable Timer1"
    select RT_USING_HWTIMER
    default n

    if BSP_USING_TIMER1
        config BSP_TIMER1_CHN0_ENABLE
            bool "Enable Timer1 Channel 0"
            default n
        config BSP_TIMER1_CHN1_ENABLE
            bool "Enable Timer1 Channel 1"
            default n
        config BSP_TIMER1_CHN2_ENABLE
            bool "Enable Timer1 Channel 2"
            default n
        config BSP_TIMER1_CHN3_ENABLE
            bool "Enable Timer1 Channel 3"
            default n                
    endif

config BSP_USING_CAMERA
    bool "Enable Camera"
    default n

    if BSP_USING_CAMERA
	    config BSP_CAMERA_SCCB_SDA_PIN
	        int "SCCB SDA pin number for camera"
	        default 15
        config BSP_CAMERA_SCCB_SDA0_PIN
            int "SCCB SDA0 pin number for gc03x8"
            default 0
        config BSP_CAMERA_SCCB_SCLK_PIN
            int "SCCB SCLK Pin"
        default 14
        config BSP_CAMERA_CMOS_RST_PIN
            int "RST Pin"
        default 13
        config BSP_CAMERA_CMOS_VSYNC_PIN
            int "VSYNC Pin"
            default 12
        config BSP_CAMERA_CMOS_PWDN_PIN
            int "PWDN Pin"
        default 11
        config BSP_CAMERA_CMOS_XCLK_PIN
            int "XCLK Pin"
        default 9
        config BSP_CAMERA_CMOS_PCLK_PIN
            int "PCLK Pin"
        default 8
        config BSP_CAMERA_CMOS_HREF_PIN
            int "HREF Pin"
        default 10
endif

menuconfig BSP_USING_RW007
    bool "Enable RW007"
    select BSP_USING_SPI1
    select BSP_SPI1_USING_SS1
    select PKG_USING_RW007
    select RT_USING_WIFI
    default n

endmenu
```

## project_0/extmods/Kconfig
```kconfig
menu "mpy-extmods"
config PRJ_USING_EXTMODS_MISC
    bool "Enable MPY extmods"
    select PKG_USING_MICROPYTHON
    select MICROPYTHON_USING_USEREXTMODS
    default y

    if PRJ_USING_EXTMODS_MISC
        menuconfig EXTMODS_MISC_USING_K210
            bool "Enable K210 extmods"
            default y

            if EXTMODS_MISC_USING_K210
                config EXTMODS_K210_LCDCTL
                    bool "Enable LCD Control"
                    default y
                config EXTMODS_K210_DVP
                    bool "Enable DVP Camera"
                    select BSP_USING_CAMERA
                    default y
                config EXTMODS_K210_I2S
                    bool "Enable I2S module"
                    default y
            endif

        config PRJ_USING_RT_AK_EXMODS
            bool "Enable RT-AK MPY module"
            default y	
		
    endif
endmenu
```
